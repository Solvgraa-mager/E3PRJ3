    IF :LNOT::DEF:INCLUDED_CYFITTERRV_INC
INCLUDED_CYFITTERRV_INC EQU 1
    GET cydevicerv_trm.inc

; Pin
Pin__0__DM__MASK EQU 0x07
Pin__0__DM__SHIFT EQU 0
Pin__0__DR EQU CYREG_PRT1_DR
Pin__0__HSIOM EQU CYREG_HSIOM_PORT_SEL1
Pin__0__HSIOM_MASK EQU 0x0000000F
Pin__0__HSIOM_SHIFT EQU 0
Pin__0__INTCFG EQU CYREG_PRT1_INTCFG
Pin__0__INTSTAT EQU CYREG_PRT1_INTSTAT
Pin__0__MASK EQU 0x01
Pin__0__PA__CFG0 EQU CYREG_UDB_PA1_CFG0
Pin__0__PA__CFG1 EQU CYREG_UDB_PA1_CFG1
Pin__0__PA__CFG10 EQU CYREG_UDB_PA1_CFG10
Pin__0__PA__CFG11 EQU CYREG_UDB_PA1_CFG11
Pin__0__PA__CFG12 EQU CYREG_UDB_PA1_CFG12
Pin__0__PA__CFG13 EQU CYREG_UDB_PA1_CFG13
Pin__0__PA__CFG14 EQU CYREG_UDB_PA1_CFG14
Pin__0__PA__CFG2 EQU CYREG_UDB_PA1_CFG2
Pin__0__PA__CFG3 EQU CYREG_UDB_PA1_CFG3
Pin__0__PA__CFG4 EQU CYREG_UDB_PA1_CFG4
Pin__0__PA__CFG5 EQU CYREG_UDB_PA1_CFG5
Pin__0__PA__CFG6 EQU CYREG_UDB_PA1_CFG6
Pin__0__PA__CFG7 EQU CYREG_UDB_PA1_CFG7
Pin__0__PA__CFG8 EQU CYREG_UDB_PA1_CFG8
Pin__0__PA__CFG9 EQU CYREG_UDB_PA1_CFG9
Pin__0__PC EQU CYREG_PRT1_PC
Pin__0__PC2 EQU CYREG_PRT1_PC2
Pin__0__PORT EQU 1
Pin__0__PS EQU CYREG_PRT1_PS
Pin__0__SHIFT EQU 0
Pin__DR EQU CYREG_PRT1_DR
Pin__INTCFG EQU CYREG_PRT1_INTCFG
Pin__INTSTAT EQU CYREG_PRT1_INTSTAT
Pin__MASK EQU 0x01
Pin__PA__CFG0 EQU CYREG_UDB_PA1_CFG0
Pin__PA__CFG1 EQU CYREG_UDB_PA1_CFG1
Pin__PA__CFG10 EQU CYREG_UDB_PA1_CFG10
Pin__PA__CFG11 EQU CYREG_UDB_PA1_CFG11
Pin__PA__CFG12 EQU CYREG_UDB_PA1_CFG12
Pin__PA__CFG13 EQU CYREG_UDB_PA1_CFG13
Pin__PA__CFG14 EQU CYREG_UDB_PA1_CFG14
Pin__PA__CFG2 EQU CYREG_UDB_PA1_CFG2
Pin__PA__CFG3 EQU CYREG_UDB_PA1_CFG3
Pin__PA__CFG4 EQU CYREG_UDB_PA1_CFG4
Pin__PA__CFG5 EQU CYREG_UDB_PA1_CFG5
Pin__PA__CFG6 EQU CYREG_UDB_PA1_CFG6
Pin__PA__CFG7 EQU CYREG_UDB_PA1_CFG7
Pin__PA__CFG8 EQU CYREG_UDB_PA1_CFG8
Pin__PA__CFG9 EQU CYREG_UDB_PA1_CFG9
Pin__PC EQU CYREG_PRT1_PC
Pin__PC2 EQU CYREG_PRT1_PC2
Pin__PORT EQU 1
Pin__PS EQU CYREG_PRT1_PS
Pin__SHIFT EQU 0

; Miscellaneous
; -- WARNING: define names containing LEOPARD or PANTHER are deprecated and will be removed in a future release
CYDEV_DEBUG_PROTECT_OPEN EQU 1
CYDEV_DEBUGGING_DPS_SWD EQU 2
CYDEV_CONFIG_UNUSED_IO_AllowButWarn EQU 0
CYDEV_CONFIGURATION_MODE_COMPRESSED EQU 0
CYDEV_CHIP_REV_PSOC4A_PRODUCTION EQU 17
CYDEV_CHIP_REVISION_4A_PRODUCTION EQU 17
CYDEV_CHIP_MEMBER_4A EQU 2
CYDEV_CHIP_FAMILY_PSOC4 EQU 2
CYDEV_CHIP_DIE_PSOC4A EQU 2
CYDEV_CHIP_DIE_EXPECT EQU CYDEV_CHIP_DIE_PSOC4A
CYDEV_BCLK__HFCLK__HZ EQU 48000000
CYDEV_BCLK__HFCLK__KHZ EQU 48000
CYDEV_BCLK__HFCLK__MHZ EQU 48
CYDEV_BCLK__SYSCLK__HZ EQU 48000000
CYDEV_BCLK__SYSCLK__KHZ EQU 48000
CYDEV_BCLK__SYSCLK__MHZ EQU 48
CYDEV_CHIP_DIE_ACTUAL EQU CYDEV_CHIP_DIE_EXPECT
CYDEV_CHIP_DIE_LEOPARD EQU 1
CYDEV_CHIP_DIE_PANTHER EQU 3
CYDEV_CHIP_DIE_PSOC5LP EQU 4
CYDEV_CHIP_DIE_UNKNOWN EQU 0
CYDEV_CHIP_FAMILY_PSOC3 EQU 1
CYDEV_CHIP_FAMILY_PSOC5 EQU 3
CYDEV_CHIP_FAMILY_UNKNOWN EQU 0
CYDEV_CHIP_FAMILY_USED EQU CYDEV_CHIP_FAMILY_PSOC4
CYDEV_CHIP_JTAG_ID EQU 0x04C81193
CYDEV_CHIP_MEMBER_3A EQU 1
CYDEV_CHIP_MEMBER_5A EQU 3
CYDEV_CHIP_MEMBER_5B EQU 4
CYDEV_CHIP_MEMBER_UNKNOWN EQU 0
CYDEV_CHIP_MEMBER_USED EQU CYDEV_CHIP_MEMBER_4A
CYDEV_CHIP_REVISION_3A_ES1 EQU 0
CYDEV_CHIP_REVISION_3A_ES2 EQU 1
CYDEV_CHIP_REVISION_3A_ES3 EQU 3
CYDEV_CHIP_REVISION_3A_PRODUCTION EQU 3
CYDEV_CHIP_REVISION_4A_ES0 EQU 17
CYDEV_CHIP_REVISION_5A_ES0 EQU 0
CYDEV_CHIP_REVISION_5A_ES1 EQU 1
CYDEV_CHIP_REVISION_5A_PRODUCTION EQU 1
CYDEV_CHIP_REVISION_5B_ES0 EQU 0
CYDEV_CHIP_REVISION_5B_PRODUCTION EQU 0
CYDEV_CHIP_REVISION_USED EQU CYDEV_CHIP_REVISION_4A_PRODUCTION
CYDEV_CHIP_REV_EXPECT EQU CYDEV_CHIP_REV_PSOC4A_PRODUCTION
CYDEV_CHIP_REV_LEOPARD_ES1 EQU 0
CYDEV_CHIP_REV_LEOPARD_ES2 EQU 1
CYDEV_CHIP_REV_LEOPARD_ES3 EQU 3
CYDEV_CHIP_REV_LEOPARD_PRODUCTION EQU 3
CYDEV_CHIP_REV_PANTHER_ES0 EQU 0
CYDEV_CHIP_REV_PANTHER_ES1 EQU 1
CYDEV_CHIP_REV_PANTHER_PRODUCTION EQU 1
CYDEV_CHIP_REV_PSOC4A_ES0 EQU 17
CYDEV_CHIP_REV_PSOC5LP_ES0 EQU 0
CYDEV_CHIP_REV_PSOC5LP_PRODUCTION EQU 0
CYDEV_CONFIGURATION_COMPRESSED EQU 1
CYDEV_CONFIGURATION_MODE EQU CYDEV_CONFIGURATION_MODE_COMPRESSED
CYDEV_CONFIGURATION_MODE_DMA EQU 2
CYDEV_CONFIGURATION_MODE_UNCOMPRESSED EQU 1
CYDEV_CONFIG_READ_ACCELERATOR EQU 1
CYDEV_CONFIG_UNUSED_IO EQU CYDEV_CONFIG_UNUSED_IO_AllowButWarn
CYDEV_CONFIG_UNUSED_IO_AllowWithInfo EQU 1
CYDEV_CONFIG_UNUSED_IO_Disallowed EQU 2
CYDEV_DEBUGGING_DPS EQU CYDEV_DEBUGGING_DPS_SWD
CYDEV_DEBUGGING_DPS_Disable EQU 3
CYDEV_DEBUGGING_ENABLE EQU 1
CYDEV_DEBUG_PROTECT EQU CYDEV_DEBUG_PROTECT_OPEN
CYDEV_DEBUG_PROTECT_KILL EQU 4
CYDEV_DEBUG_PROTECT_PROTECTED EQU 2
CYDEV_HEAP_SIZE EQU 0x0100
CYDEV_PROJ_TYPE EQU 0
CYDEV_PROJ_TYPE_BOOTLOADER EQU 1
CYDEV_PROJ_TYPE_LOADABLE EQU 2
CYDEV_PROJ_TYPE_MULTIAPPBOOTLOADER EQU 3
CYDEV_PROJ_TYPE_STANDARD EQU 0
CYDEV_STACK_SIZE EQU 0x0400
CYDEV_USE_BUNDLED_CMSIS EQU 1
CYDEV_VARIABLE_VDDA EQU 1
CYDEV_VDDA_MV EQU 3300
CYDEV_VDDD_MV EQU 3300
CYDEV_BOOTLOADER_ENABLE EQU 0
    ENDIF
    END
